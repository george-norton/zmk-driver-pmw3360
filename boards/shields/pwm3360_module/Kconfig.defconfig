## boards/shields/pwm3360_module/Kconfig.defconfig
```kconfig
# Copyright (c) 2019 Linaro Limited
# SPDX-License-Identifier: Apache-2.0

if SHIELD_PMW3360_MODULE

config ZMK_KEYBOARD_NAME
    default "PMW3360 Shield"

endif # SHIELD_PMW3360_MODULE
```

## boards/shields/pwm3360_module/Kconfig.shield
```kconfig
# Copyright (c) 2025 George Norton
# SPDX-License-Identifier: MIT

config SHIELD_PMW3360_MODULE
	def_bool $(shields_list_contains,pmw3360_module)
	imply ZMK_MOUSE
	select pinctrl
	select GPIO
	select INPUT
	select SPI
```

## drivers/input/Kconfig
```kconfig
# Copyright (c) 2025 George Norton
# SPDX-License-Identifier: MIT
#
# PMW3360 optical mouse sensor driver

menuconfig INPUT_PIXART_PMW3360
    bool "PMW3360 optical mouse sensor"
    default y
    select GPIO
    select SPI
    depends on INPUT
    depends on DT_HAS_PIXART_PMW3360_ENABLED
    help
      Enable PMW3360 optical mouse sensor.

config INPUT_PIXART_PMW3360_USE_OWN_THREAD
    bool "Create a thread for the PMW3360 driver."
    default y

config INPUT_PIXART_PMW3360_THREAD_PRIORITY
    int "The priority of the PWM3360 driver thread."
    depends on INPUT_PIXART_PMW3360_USE_OWN_THREAD
    default 5

config INPUT_PIXART_PMW3360_THREAD_STACK_SIZE
    int "The stack size of the PWM3360 driver thread."
    depends on INPUT_PIXART_PMW3360_USE_OWN_THREAD
    default 768
```

## dts/bindings/input/pixart,pmw3360.yaml
```yaml
# Copyright (c) 2025 The ZMK Contributors
# SPDX-License-Identifier: MIT
description: |
  Sensor driver for the pixart PMW3360 optical mouse sensor 

compatible: "pixart,pmw3360"

include: spi-device.yaml

properties:
  irq-gpios:
    type: phandle-array
    required: true
  cpi:
    type: int
    default: 600
    description: "CPI value (Range: 50 - 8200)"
  rotate-90:
    type: boolean
    description: "The sensor is installed rotated 90 degrees. Rotation properties are mutually exclusive."
  rotate-180:
    type: boolean
    description: "The sensor is installed rotated 180 degrees. Rotation properties are mutually exclusive."
  rotate-270:
    type: boolean
    description: "The sensor is installed rotated 270 degrees. Rotation properties are mutually exclusive."
  angle-tune:
    type: int
    default: 0 
    description: "Adjust the sensor angle in degrees (Range: -30 - 30)."
  lift-height-3mm:
    type: boolean
    description: "Configure the lift-off height to be 3mm rather than the default 2mm."
```
